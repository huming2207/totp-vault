## main/Kconfig.projbuild
```kconfig
menu "LittleVGL Display configuration"

    config LVGL_SPI_MOSI
        int "SPI MOSI Pin"
        default 23
        help
            SPI MOSI Pin

    config LVGL_SPI_MISO
        int "SPI MISO Pin"
        default -1
        help
            SPI MISO pin, leave -1 for ST7789.

    config LVGL_SPI_CS
        int "SPI Chip Select pin"
        default 5
        help
            SPI Chip Select pin

    config LVGL_SPI_SCLK
        int "SPI Clock pin"
        default 18
        help
            SPI Clock pin

    config LVGL_IO_DC
        int "Data/Command IO pin"
        default 2
        help
            Data/Command IO pin

    config LVGL_IO_RST
        int "Reset IO pin"
        default 4
        help
            Reset IO pin

    config LVGL_SPI_CLK_DEBUG
        bool "SPI debug mode (slower clock speed)"
        default n
        help
            Slow down the SPI to 8.8MHz to make the logic analyser's life easier,
            otherwise the speed goes to 40MHz for better performance.

endmenu
```
